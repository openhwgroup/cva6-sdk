## configs/u200/uboot64_defconfig
```kconfig
CONFIG_RISCV=y
CONFIG_SYS_MALLOC_LEN=0x00800000
CONFIG_HAS_CUSTOM_SYS_INIT_SP_ADDR=y
CONFIG_CUSTOM_SYS_INIT_SP_ADDR=0x80200000
CONFIG_DEFAULT_DEVICE_TREE="cv64a6_imafdc_sv39"
CONFIG_SYS_BOOTM_LEN=0x08000000
CONFIG_SYS_LOAD_ADDR=0x88000000
CONFIG_TARGET_OPENHWGROUP_CVA6_U200=y
CONFIG_ARCH_RV64I=y
CONFIG_RISCV_SMODE=y
CONFIG_FIT=y
# CONFIG_LEGACY_IMAGE_FORMAT is not set
CONFIG_BOOTDELAY=5
CONFIG_OF_BOARD_SETUP=y
CONFIG_USE_BOOTCOMMAND=y
CONFIG_BOOTCOMMAND="setenv fdt_high 0xffffffffffffffff; bootm 0x88000000"
CONFIG_DISPLAY_CPUINFO=y
CONFIG_CMD_PING=y
CONFIG_SYS_NS16550=y
# CONFIG_RANDOM_UUID is not set
```

## tree32.its
```
/dts-v1/;

/ {
    description = "CV32A6Linux";
    #address-cells = <1>;

    images {
            kernel-1 {
                description = "Linux Kernel";
                data = /incbin/("install32/Image.gz");
                type = "kernel";
                arch = "riscv";
                os = "linux";
                compression = "gzip";
                load = <0x80400000>;
                entry = <0x80400000>;
                hash {
                algo = "sha256";
                };
            };
            fdt-1 {
                    description = "DTB";
                    data = /incbin/("buildroot/output/build/uboot-custom/dts/dt.dtb");
                    type = "flat_dt";
                    arch = "riscv";
                    compression = "none";
                    hash {
                        algo = "sha256";
                    };
            };
            ramdisk-1 {
                    description = "Initial ramdisk";
                    data = /incbin/("install32/rootfs.cpio.gz");
                    type = "ramdisk";
                    arch = "riscv";
                    os = "linux";
                    hash-1 {
                            algo = "sha256";
                    };
            };
    };

    configurations {
            default = "standard";
            standard {
                    description = "Standard Boot";
                    kernel = "kernel-1";
                    fdt = "fdt-1";
                    ramdisk = "ramdisk-1";
            };
    };
};
```

## tree64.its
```
/dts-v1/;

/ {
    description = "CV64A6Linux";
    #address-cells = <1>;

    images {
            kernel-1 {
                description = "Linux Kernel";
                data = /incbin/("install64/Image.gz");
                type = "kernel";
                arch = "riscv";
                os = "linux";
                compression = "gzip";
                load = <0x80200000>;
                entry = <0x80200000>;
                hash {
                algo = "sha256";
                };
            };
            fdt-1 {
                    description = "DTB";
                    data = /incbin/("buildroot/output/build/uboot-custom/dts/dt.dtb");
                    type = "flat_dt";
                    arch = "riscv";
                    compression = "none";
                    hash {
                        algo = "sha256";
                    };
            };
            ramdisk-1 {
                    description = "Initial ramdisk";
                    data = /incbin/("install64/rootfs.cpio.gz");
                    type = "ramdisk";
                    arch = "riscv";
                    os = "linux";
                    hash-1 {
                            algo = "sha256";
                    };
            };
    };

    configurations {
            default = "standard";
            standard {
                    description = "Standard Boot";
                    kernel = "kernel-1";
                    fdt = "fdt-1";
                    ramdisk = "ramdisk-1";
            };
    };
};
```
